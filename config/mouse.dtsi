#include <dt-bindings/zmk/pointing.h>

&mmv {
  acceleration-exponent = <1>;      
  time-to-max-speed-ms = <700>;    
  delay-ms = <0>;                   
};

&msc {
  acceleration-exponent = <1>;      
  time-to-max-speed-ms = <300>;    
  delay-ms = <0>;                   
};

#define U_BTN1 &mkp MB1
#define U_BTN2 &mkp MB2
#define U_BTN3 &mkp MB3
#define U_MS_U &mmv MOVE_UP
#define U_MS_D &mmv MOVE_DOWN
#define U_MS_L &mmv MOVE_LEFT
#define U_MS_R &mmv MOVE_RIGHT
#define U_WH_U &msc SCRL_UP
#define U_WH_D &msc SCRL_DOWN
#define U_WH_L &msc SCRL_LEFT
#define U_WH_R &msc SCRL_RIGHT
